## drivers/input/fingerprint/Kconfig
```kconfig
#
#Fingerprint
#

config MTK_FINGERPRINT
	tristate "Mediatek Fingerprint"
	default n
	---help---

source "drivers/input/fingerprint/gsl6163/Kconfig"
source "drivers/input/fingerprint/gfx1xm/Kconfig"
source "drivers/input/fingerprint/et320/Kconfig"
source "drivers/input/fingerprint/a120n/Kconfig"
source "drivers/input/fingerprint/jmt101/Kconfig"
source "drivers/input/fingerprint/sw9362n/Kconfig"
source "drivers/input/fingerprint/gf3208/Kconfig"
source "drivers/input/fingerprint/sunwave_fp/Kconfig"
```

## drivers/input/touchscreen/mediatek/FT5406_MT/Kconfig
```kconfig
#
# Touchscreen driver configuration
#
if TOUCHSCREEN_MTK_FT5406_MT

config TPD_ROTATE_90
	bool "FT5406_MT for Mediatek package"
	default n
	help
	Say Y here if you have FT5406_MT touch panel TPD_ROTATE_90.

	If unsure, say N.

	To compile this dirver as a module, choose M here: the
	module will be called.

config TPD_ROTATE_180
	bool "FT5406_MT for Mediatek package"
	default n
	help
	Say Y here if you have FT5406_MT touch panel TPD_ROTATE_180.

	If unsure, say N.

	To compile this dirver as a module, choose M here: the
	module will be called.

config TPD_ROTATE_270
	bool "FT5406_MT for Mediatek package"
	default n
	help
	Say Y here if you have FT5406_MT touch panel TPD_ROTATE_270.

	If unsure, say N.

	To compile this dirver as a module, choose M here: the
	module will be called.

endif
```

## drivers/input/touchscreen/mediatek/Kconfig
```kconfig
#
# Touchscreen driver configuration
#
menuconfig INPUT_TOUCHSCREEN
	bool "Touchscreens"
	help
	  Say Y here, and a list of supported touchscreens will be displayed.
	  This option doesn't affect the kernel.

	  If unsure, say Y.

if INPUT_TOUCHSCREEN

config TOUCHSCREEN_MTK
	bool "MediaTek Touch Panel Driver"
	default n
	help
	  Say Y here if you have MediaTek touch panel.

	  If unsure, say N.

	  To compile this dirver as a module, choose M here: the
	  module will be called.

config TOUCHSCREEN_MTK_GT9XX_GESTURE
	bool "GT9XX_GESTURE for Mediatek package"
	default n
	help
	  Say Y here if you have GT9XX_GESTURE touch panel.

	  If unsure, say N.

	  To compile this dirver as a module, choose M here: the
	  module will be called.

source "drivers/input/touchscreen/mediatek/GT9XX_GESTURE/Kconfig"

config TOUCHSCREEN_MTK_GT1X
	bool "GT1X for Mediatek package"
	default n
	help
	  Say Y here if you have GT1X touch panel.

	  If unsure, say N.

	  To compile this dirver as a module, choose M here: the
	  module will be called.

source "drivers/input/touchscreen/mediatek/GT1X/Kconfig"

config TOUCHSCREEN_MTK_FT5406_MT
	bool "FT5406_MT for Mediatek package"
	default n
	help
	  Say Y here if you have FT5406_MT touch panel.

	  If unsure, say N.

	  To compile this dirver as a module, choose M here: the
	  module will be called.

source "drivers/input/touchscreen/mediatek/FT5406_MT/Kconfig"

config TOUCHSCREEN_MTK_S2202
	bool "S2202 for Mediatek package"
	default n
	help
	  Say Y here if you have S2202 touch panel.

	  If unsure, say N.

	  To compile this dirver as a module, choose M here: the
	  module will be called.

source "drivers/input/touchscreen/mediatek/S2202/Kconfig"

endif
```

## drivers/input/touchscreen/mediatek/S2202/Kconfig
```kconfig
#
# Touchscreen driver configuration
#
if TOUCHSCREEN_MTK_S2202

config TPD_ROTATE_90
	bool "S2202 for Mediatek package"
	default n
	help
	Say Y here if you have S2202 touch panel TPD_ROTATE_90.

	If unsure, say N.

	To compile this dirver as a module, choose M here: the
	module will be called.

config TPD_ROTATE_180
	bool "S2202 for Mediatek package"
	default n
	help
	Say Y here if you have S2202 touch panel TPD_ROTATE_180.

	If unsure, say N.

	To compile this dirver as a module, choose M here: the
	module will be called.

config TPD_ROTATE_270
	bool "S2202 for Mediatek package"
	default n
	help
	Say Y here if you have S2202 touch panel TPD_ROTATE_270.

	If unsure, say N.

	To compile this dirver as a module, choose M here: the
	module will be called.

endif
```

## drivers/misc/mediatek/cam_version/Kconfig
```kconfig
config MTK_CAMERA_VERSION
	tristate "MediaTek camera driver"
	---help---
	  Camera driver support for MediaTek SOC
	  If you want to use MediaTek camera driver,
	  say Y or M here.
	  If unsure, say N.
```

## drivers/misc/mediatek/imgsensor/Kconfig
```kconfig
config MTK_IMGSENSOR
	tristate "enable MTK cam driver"
	default n
	help
	  It support different sensor.
          If this option is set to m,
          it will build module.

config MTK_CAM_MAX_NUMBER_OF_CAMERA
	int "max number of camera supported"
	default 2
	help
	  max number of camera supported

config MTK_EFUSE_DOWNGRADE
	tristate "a variant of downgrade chip"
	default n
	help
	  a variant of downgrade chip

config MTK_CAMERA_VERSION
	tristate "a variant of print camera version"
	default n
	help
	  a variant of print camera version
```

## drivers/misc/mediatek/temperature/Kconfig
```kconfig
config CUSTOM_KERNEL_AMBIENT_TEMPURATURE
	bool "CUSTOM_KERNEL_AMBIENT_TEMPURATURE"
	help
		To detect humidity raw data


source "drivers/misc/mediatek/temperature/hshcal002/Kconfig"
```
